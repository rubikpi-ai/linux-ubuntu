## Documentation/devicetree/bindings/display/bridge/ite,it6162.yaml
```yaml
# SPDX-License-Identifier: (GPL-2.0 OR BSD-2-Clause)
%YAML 1.2
---
$id: http://devicetree.org/schemas/display/bridge/ite,it6162.yaml#
$schema: http://devicetree.org/meta-schemas/core.yaml#

title: ITE IT6162 MIPI DSI to HDMI Bridge

maintainers:
  - Pet Weng <pet.weng@ite.com.tw>
  - Hermes Wu <hermes.wu@ite.com.tw>

description:
  The IT6162 is a MIPI DSI to HDMI bridge chip.

properties:
  compatible:
    const: ite,it6162

  reg:
    maxItems: 1

  interrupts:
    maxItems: 1

  interrupts-extended:
    maxItems: 1

  reset-gpios:
    maxItems: 1
    description: GPIO connected to active low reset.

  ivdd-supply:
    description: Regulator for core/internal supply (optional).

  pwr18-supply:
    description: Regulator for 1.8 V power rail (optional).

  ovdd-supply:
    description: Regulator for I/O power rail (optional).

  ite,i2s-audio:
    type: boolean
    description:
      Enable HDMI audio support via I2S/SPDIF through the HDMI codec
      platform driver.

  ports:
    $ref: /schemas/graph.yaml#/properties/ports
    description: |
      Video input (MIPI DSI) and HDMI output connections.

    properties:
      port@0:
        $ref: /schemas/graph.yaml#/$defs/port-base
        unevaluatedProperties: false
        description: First MIPI DSI input port.

        properties:
          endpoint:
            $ref: /schemas/graph.yaml#/$defs/endpoint-base
            unevaluatedProperties: false

            properties:
              data-lanes:
                description:
                  List of data lane indexes used by the DSI link.
                minItems: 1
                maxItems: 4
                items:
                  minimum: 0
                  maximum: 3

              ite,mipi-dsi-phy-pn-swap:
                type: boolean
                description: Swap P/N polarity of DSI data lanes.

              ite,mipi-dsi-phy-link-swap:
                type: boolean
                description: Swap DSI lane mapping on the receiver.

              ite,mipi-dsi-mode-video-sync-pulse:
                type: boolean
                description:
                  Use video sync-pulse mode instead of sync-event mode.

              ite,mipi-dsi-clock-non-continous:
                type: boolean
                description:
                  Enable non-continuous DSI clock mode.

            required:
              - data-lanes

      port@1:
        $ref: /schemas/graph.yaml#/$defs/port-base
        unevaluatedProperties: false
        description: Optional second MIPI DSI input port.

        properties:
          endpoint:
            $ref: /schemas/graph.yaml#/$defs/endpoint-base
            unevaluatedProperties: false

            properties:
              data-lanes:
                description:
                  List of data lane indexes used by the DSI link.
                minItems: 1
                maxItems: 4
                items:
                  minimum: 0
                  maximum: 3

              ite,mipi-dsi-phy-pn-swap:
                type: boolean
                description: Swap P/N polarity of DSI data lanes.

              ite,mipi-dsi-phy-link-swap:
                type: boolean
                description: Swap DSI lane mapping on the receiver.

              ite,mipi-dsi-mode-video-sync-pulse:
                type: boolean
                description:
                  Use video sync-pulse mode instead of sync-event mode.

              ite,mipi-dsi-clock-non-continous:
                type: boolean
                description:
                  Enable non-continuous DSI clock mode.

      port@2:
        $ref: /schemas/graph.yaml#/properties/port
        description: |
          HDMI port, should be connected to a node compatible with the
          hdmi-connector binding.
        properties:
          endpoint:
            $ref: /schemas/graph.yaml#/$defs/endpoint-base
            unevaluatedProperties: false
        unevaluatedProperties: false

    required:
      - port@0
      - port@2

required:
  - compatible
  - reg
  - ports

additionalProperties: false

examples:
  - |
    #include <dt-bindings/interrupt-controller/irq.h>
    #include <dt-bindings/gpio/gpio.h>

    i2c1 {
        #address-cells = <1>;
        #size-cells = <0>;
        status = "okay";
        clock-frequency = <400000>;

        it6162_1_codec: hdmi-bridge@58 {
            compatible = "ite,it6162";
            reg = <0x58>;

            /* using interrupts-extended, as in your board DTS */
            interrupts-extended = <&tlmm 95 IRQ_TYPE_LEVEL_LOW>;

            reset-gpios = <&tlmm 96 GPIO_ACTIVE_LOW>;

            ivdd-supply = <&vdd_it6162_core>;
            pwr18-supply = <&vdd_it6162_1p8>;
            ovdd-supply = <&vdd_it6162_io>;

            pinctrl-names = "default";
            pinctrl-0 = <&it6162_1_irq_pin>;

            /* enable audio over I2S/SPDIF if wired */
            ite,i2s-audio;

            ports {
                #address-cells = <1>;
                #size-cells = <0>;

                port@0 {
                    reg = <0>;

                    it6162_1_a: endpoint {
                        data-lanes = <0 1 2 3>;
                        // Optional tuning properties:
                        // ite,mipi-dsi-phy-pn-swap;
                        // ite,mipi-dsi-phy-link-swap;
                        // ite,mipi-dsi-mode-video-sync-pulse;
                        // ite,mipi-dsi-clock-non-continous;
                        remote-endpoint = <&mdss0_dsi0_out>;
                    };
                };

                /* Optional second DSI input if used */
                port@1 {
                    reg = <1>;
                    it6162_1_b: endpoint {
                        data-lanes = <0 1 2 3>;
                        remote-endpoint = <&mdss1_dsi0_out>;
                    };
                };

                /* HDMI Output Port */
                port@2 {
                    reg = <2>;
                    it6162_hdmi_out: endpoint {
                        remote-endpoint = <&hdmi_connector_in>;
                    };
                };
            };
        };
    };

    hdmi_connector: connector {
        compatible = "hdmi-connector";
        label = "hdmi";

        port {
            hdmi_connector_in: endpoint {
                remote-endpoint = <&it6162_hdmi_out>;
            };
        };
    };
```
